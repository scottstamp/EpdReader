## CMakeLists.txt
```
cmake_minimum_required(VERSION 3.20.0)

find_package(Zephyr REQUIRED HINTS $ENV{ZEPHYR_BASE})
project(nrf_epd_zephyr)

target_include_directories(app PRIVATE
    ${CMAKE_CURRENT_SOURCE_DIR}/src
    ${CMAKE_CURRENT_SOURCE_DIR}/drivers/display
    ${CMAKE_CURRENT_SOURCE_DIR}/src/third_party/tjpgd
)

target_sources(app PRIVATE
    src/main.c
    src/app.c
    src/book.c
    src/screen_home.c
    src/screen_library.c
    src/screen_reader.c
    src/screen_settings.c
    src/screen_lists.c
    src/screen_transfer.c
    src/screen_sleep.c
    src/display.c
    drivers/display/display_gdey037t03.c
    src/storage.c
    src/buttons.c
    src/ble.c
    src/ble_upload.c
    src/upload_proto.c
    src/battery.c
    src/prefs.c
    src/lists_doc.c
    src/lists.c
    src/lists_ble.c
    src/inflate_stream.c
    src/dither.c
    src/html_text.c
    src/epub.c
    src/font_extended.c
    src/third_party/tjpgd/tjpgd.c
)
```

## Kconfig
```
mainmenu "nRF e-Paper Reader Application"

rsource "drivers/display/Kconfig"

source "Kconfig.zephyr"
```

## west.yml
```
manifest:
  remotes:
    - name: ncs
      url-base: https://github.com/nrfconnect

  projects:
    # nRF Connect SDK. Importing it pulls in the matching sdk-zephyr fork
    # and the modules this app needs. Only used to create a workspace from
    # scratch (CI); local builds with an installed NCS ignore this file.
    - name: nrf
      remote: ncs
      repo-path: sdk-nrf
      revision: v3.4.1
      import:
        # Only the projects the build actually uses (checked against
        # zephyr_modules.txt of a full-NCS build: same zephyr.bin), so CI
        # doesn't clone all of NCS. Add a module here if a new Kconfig
        # option needs one (e.g. littlefs, mbedtls, mcuboot).
        name-allowlist:
          - zephyr
          - nrfxlib     # SoftDevice Controller, MPSL
          - hal_nordic  # nrfx
          - cmsis_6
          - fatfs

  self:
    path: nrf_epd
```

## prj.conf
```kconfig
# Zephyr & nRF Connect SDK Configuration for e-Paper Book Reader

# Kernel & System Options
CONFIG_MAIN_STACK_SIZE=16384
CONFIG_SYSTEM_WORKQUEUE_STACK_SIZE=4096

# Power Management & System OFF Deep Sleep
CONFIG_PM_DEVICE=y
CONFIG_POWEROFF=y
CONFIG_REBOOT=y

# Peripheral Drivers
CONFIG_GPIO=y
CONFIG_SPI=y
CONFIG_ADC=y
CONFIG_ADC_ASYNC=y
CONFIG_DISPLAY=y
CONFIG_DISPLAY_GDEY037T03=y

# Disk Access & File Systems
CONFIG_DISK_ACCESS=y
CONFIG_DISK_DRIVERS=y
CONFIG_FILE_SYSTEM=y
CONFIG_FAT_FILESYSTEM_ELM=y
CONFIG_FS_FATFS_LFN=y
CONFIG_FS_FATFS_MAX_LFN=255
CONFIG_FLASH=y
CONFIG_FLASH_MAP=y

# User preferences & stats in internal flash (storage_partition)
CONFIG_NVS=y
CONFIG_SETTINGS=y
CONFIG_SETTINGS_NVS=y

# Bluetooth LE Stack
CONFIG_BT=y
CONFIG_BT_PERIPHERAL=y
CONFIG_BT_DEVICE_NAME="nRF EPD Reader"
CONFIG_BT_DEVICE_APPEARANCE=833
CONFIG_BT_BAS=y
CONFIG_BT_DIS=y
CONFIG_BT_DIS_PNP=n
CONFIG_BT_DIS_MANUF_NAME_STR="NiceKeyboards"
CONFIG_BT_DIS_MODEL_NUMBER_STR="NiceNano V2"

# Bluetooth Services (Nordic UART Service for Book Upload)
CONFIG_BT_L2CAP_TX_MTU=247
CONFIG_BT_BUF_ACL_RX_SIZE=251
CONFIG_BT_BUF_ACL_TX_SIZE=251
# Ask for a 15-30 ms connection interval (default 30-50 ms) for faster uploads;
# Bluetooth is only on while the upload screen is open
CONFIG_BT_PERIPHERAL_PREF_MIN_INT=12
CONFIG_BT_PERIPHERAL_PREF_MAX_INT=24

# USB CDC-ACM Serial Console & USB Mass Storage (SD Drive Mode)
CONFIG_USB_DEVICE_STACK_NEXT=y
CONFIG_CDC_ACM_SERIAL_INITIALIZE_AT_BOOT=n
CONFIG_USBD_CDC_ACM_CLASS=y
CONFIG_USBD_MSC_CLASS=y
CONFIG_SERIAL=y
CONFIG_UART_INTERRUPT_DRIVEN=y
CONFIG_UART_LINE_CTRL=y

# Logging & Console
CONFIG_LOG=y
CONFIG_LOG_DEFAULT_LEVEL=1
# Panel driver timing lines and BUSY warnings
CONFIG_DISPLAY_LOG_LEVEL_INF=y
CONFIG_CONSOLE=y
CONFIG_UART_CONSOLE=y
CONFIG_CBPRINTF_FP_SUPPORT=y
```

## dts/bindings/display/gooddisplay,gdey037t03.yaml
```yaml
description: Good Display GDEY037T03 3.7-inch e-Paper display controller (UC8253)

compatible: "gooddisplay,gdey037t03"

include: [spi-device.yaml, display-controller.yaml]

properties:
  dc-gpios:
    type: phandle-array
    required: true
    description: Data/Command control GPIO pin

  reset-gpios:
    type: phandle-array
    required: true
    description: Hardware Reset GPIO pin

  busy-gpios:
    type: phandle-array
    required: true
    description: Hardware Busy status GPIO pin (Active LOW)

  vcc-gpios:
    type: phandle-array
    required: false
    description: Power rail control GPIO pin (Active LOW MOSFET)
```

## src/main.c
```c
#include <zephyr/kernel.h>
#include <zephyr/logging/log.h>
#include <hal/nrf_power.h>
#include "app.h"
#include "battery.h"
#include "book.h"
#include "buttons.h"
#include "display.h"
#include "screens.h"
#include "storage.h"

LOG_MODULE_REGISTER(main, LOG_LEVEL_INF);

// The screen to start on: the one shown before sleep, else the home carousel with the
// last opened book ready to continue
static SystemState restore_session(void) {
    int state = -1;
    int home_idx = 0;
    char book[64] = {0};
    uint32_t offset = 0;

    if (!storage_read_sleep_state(&state, &home_idx, book) || state < 0) {
        if (storage_read_progress(book, &offset) && book[0] != '\0') {
            book_restore(book, offset);
        }
        return STATE_MENU;
    }
    storage_clear_sleep_state();

    if (book[0] != '\0') {
        storage_read_book_progress(book, &offset);
        book_restore(book, offset);
    }
    switch (state) {
        case STATE_READER:
        case STATE_READER_MENU:
            return STATE_READER;
        case STATE_BOOK_LIST:
            return STATE_BOOK_LIST;
        default:
            home_set_selection(home_idx);
            return STATE_MENU;
    }
}

int main(void) {
    // Clear the "boot into the UF2 bootloader" request in case it was left set
    nrf_power_gpregret_set(NRF_POWER, 0, 0);

    usb_init();
    LOG_INF("Starting nRF e-Paper Book Reader (Zephyr RTOS)");

    // Mount the SD card first: display_init loads the SD font from it
    storage_init();
    display_init();
    book_init();
    buttons_init();
    battery_init();
    user_settings_load();

    app_run(restore_session());
    return 0;
}
```

## src/AmazonEmber_Medium12pt7b.h
```c
#ifndef AMAZON_EMBER_MEDIUM_12PT7B_H
#define AMAZON_EMBER_MEDIUM_12PT7B_H

#include "gfxfont.h"

const uint8_t AmazonEmber_Medium12pt7bBitmaps[] PROGMEM = {
    0x66, 0x66, 0x66, 0x66, 0x06, 0x66, 0x6C, 0xD9, 0xB3, 0x66, 0xC0, 0x00,
    0x00, 0x00, 0x00, 0x00, 0x00, 0x10, 0x82, 0x10, 0x42, 0x3F, 0xF3, 0x18,
    0x63, 0x0C, 0x61, 0x08, 0xFF, 0xCC, 0x61, 0x8C, 0x31, 0x80, 0x04, 0x00,
    0x80, 0x7C, 0x1F, 0xC6, 0x48, 0xC8, 0x1D, 0x01, 0xF0, 0x0F, 0x80, 0xB8,
    0x13, 0x32, 0x67, 0xF8, 0x7E, 0x01, 0x00, 0x20, 0x38, 0x30, 0x36, 0x10,
    0x1B, 0x18, 0x0D, 0x88, 0x06, 0xCC, 0x03, 0x64, 0x70, 0xE6, 0x6C, 0x02,
    0x36, 0x03, 0x1B, 0x01, 0x0D, 0x81, 0x86, 0xC0, 0x81, 0xC0, 0x1F, 0x01,
    0xFC, 0x0C, 0x60, 0x63, 0x01, 0xB0, 0x0F, 0x30, 0xF9, 0x8E, 0xFC, 0x63,
    0xC3, 0x0E, 0x1F, 0xFC, 0x3C, 0xE0, 0x66, 0x66, 0x60, 0x00, 0x00, 0x00,
    0x18, 0x63, 0x0C, 0x31, 0x86, 0x18, 0x61, 0x86, 0x18, 0x30, 0xC3, 0x06,
    0x18, 0x61, 0x83, 0x0C, 0x30, 0x61, 0x86, 0x18, 0x61, 0x86, 0x30, 0xC3,
    0x18, 0x60, 0x10, 0xA9, 0xF0, 0x82, 0x85, 0x00, 0x00, 0x00, 0x00, 0x00,
    0x00, 0x0C, 0x01, 0x80, 0x30, 0x3F, 0xC7, 0xF8, 0x18, 0x03, 0x00, 0x60,
    0x00, 0x00, 0x00, 0x73, 0x39, 0x8C, 0x00, 0x7C, 0xF8, 0x00, 0x00, 0x00,
    0x00, 0x63, 0x98, 0x03, 0x01, 0x81, 0x80, 0xC0, 0x60, 0x60, 0x30, 0x38,
    0x18, 0x0C, 0x0E, 0x06, 0x03, 0x03, 0x01, 0x80, 0xC0, 0xC0, 0x00, 0x1F,
    0x07, 0xF0, 0xC6, 0x30, 0x66, 0x0C, 0xC1, 0x98, 0x33, 0x06, 0x60, 0xC6,
    0x30, 0xFE, 0x0F, 0x80, 0x0E, 0x07, 0xC0, 0xD8, 0x03, 0x00, 0x60, 0x0C,
    0x01, 0x80, 0x30, 0x06, 0x00, 0xC0, 0x18, 0x03, 0x00, 0x1F, 0x0F, 0xF1,
    0x86, 0x00, 0xC0, 0x18, 0x06, 0x01, 0x80, 0x60, 0x18, 0x06, 0x01, 0xFF,
    0x3F, 0xE0, 0x7F, 0x8F, 0xF0, 0x0C, 0x03, 0x00, 0xC0, 0x3E, 0x07, 0xE0,
    0x0E, 0x00, 0xC8, 0x39, 0xFE, 0x1F, 0x80, 0x03, 0x00, 0xE0, 0x3C, 0x0F,
    0x81, 0xB0, 0x66, 0x18, 0xC3, 0xFE, 0x7F, 0xC0, 0x60, 0x0C, 0x01, 0x80,
    0x3F, 0x87, 0xF0, 0xC0, 0x18, 0x03, 0x00, 0x7E, 0x0F, 0xE0, 0x0E, 0x00,
    0xC8, 0x39, 0xFE, 0x1F, 0x80, 0x0F, 0x83, 0xF0, 0xC0, 0x30, 0x06, 0xF0,
    0xFF, 0x18, 0x73, 0x06, 0x60, 0xC6, 0x38, 0xFE, 0x0F, 0x80, 0x7F, 0xCF,
    0xF8, 0x03, 0x00, 0xC0, 0x18, 0x06, 0x00, 0xC0, 0x30, 0x06, 0x01, 0x80,
    0x30, 0x0E, 0x00, 0x1F, 0x07, 0xF1, 0xC7, 0x30, 0x67, 0x1C, 0x3E, 0x0F,
    0xE3, 0x0E, 0x60, 0xCE, 0x39, 0xFE, 0x0F, 0x80, 0x1F, 0x07, 0xF1, 0xC6,
    0x30, 0x66, 0x0C, 0xE1, 0x8F, 0xF0, 0xF6, 0x01, 0xC0, 0x31, 0xFC, 0x1F,
    0x00, 0x63, 0x98, 0x00, 0x01, 0x8E, 0x60, 0x63, 0x98, 0x00, 0x00, 0x0E,
    0x67, 0x31, 0x80, 0x00, 0x80, 0x70, 0x3C, 0x3C, 0x06, 0x00, 0xF0, 0x03,
    0xC0, 0x1C, 0x00, 0x80, 0x00, 0x00, 0x00, 0x7F, 0x8F, 0xF0, 0x00, 0x00,
    0x07, 0xF8, 0xFF, 0x00, 0x00, 0x00, 0x00, 0x00, 0x40, 0x0E, 0x00, 0xF0,
    0x03, 0xC0, 0x18, 0x0F, 0x0F, 0x03, 0x80, 0x40, 0x00, 0x00, 0x00, 0x00,
    0x7C, 0xFE, 0x86, 0x06, 0x0C, 0x38, 0x30, 0x30, 0x00, 0x30, 0x30, 0x30,
    0x01, 0xF8, 0x01, 0xFF, 0x80, 0xE0, 0x70, 0x60, 0x0C, 0x31, 0xF9, 0x8C,
    0xFE, 0x66, 0x31, 0x19, 0x98, 0x46, 0x66, 0x31, 0x99, 0x8C, 0xC6, 0x7F,
    0xF1, 0x8E, 0x78, 0x30, 0x00, 0x0E, 0x00, 0x01, 0xFE, 0x00, 0x1F, 0x80,
    0x0E, 0x01, 0xC0, 0x6C, 0x0D, 0x81, 0xB0, 0x63, 0x0C, 0x61, 0xFC, 0x7F,
    0xCC, 0x19, 0x83, 0x60, 0x30, 0x7E, 0x0F, 0xF1, 0x8E, 0x30, 0xC6, 0x38,
    0xFE, 0x1F, 0xE3, 0x0E, 0x60, 0xCC, 0x39, 0xFE, 0x3F, 0x80, 0x0F, 0xC3,
    0xF8, 0xE0, 0x38, 0x06, 0x00, 0xC0, 0x18, 0x03, 0x00, 0x70, 0x07, 0x00,
    0xFF, 0x07, 0xE0, 0x7F, 0x07, 0xF8, 0x61, 0xC6, 0x0E, 0x60, 0x66, 0x06,
    0x60, 0x66, 0x06, 0x60, 0xE6, 0x1C, 0x7F, 0x87, 0xF0, 0x7F, 0x9F, 0xE6,
    0x01, 0x80, 0x60, 0x1F, 0xC7, 0xF1, 0x80, 0x60, 0x18, 0x07, 0xF9, 0xFE,
    0x7F, 0x9F, 0xE6, 0x01, 0x80, 0x60, 0x1F, 0xC7, 0xF1, 0x80, 0x60, 0x18,
    0x06, 0x01, 0x80, 0x0F, 0xC0, 0xFF, 0x0E, 0x08, 0xE0, 0x06, 0x00, 0x31,
    0xF1, 0x8F, 0x8C, 0x0C, 0x70, 0x61, 0xC3, 0x07, 0xF8, 0x1F, 0x80, 0x60,
    0x63, 0x03, 0x18, 0x18, 0xC0, 0xC6, 0x06, 0x3F, 0xF1, 0xFF, 0x8C, 0x0C,
    0x60, 0x63, 0x03, 0x18, 0x18, 0xC0, 0xC0, 0x63, 0x18, 0xC6, 0x31, 0x8C,
    0x63, 0x18, 0xC0, 0x0C, 0x0C, 0x0C, 0x0C, 0x0C, 0x0C, 0x0C, 0x0C, 0x0C,
    0x0C, 0xFC, 0xF8, 0x60, 0xC6, 0x18, 0x63, 0x06, 0x60, 0x6C, 0x07, 0x80,
    0x6C, 0x06, 0x60, 0x63, 0x06, 0x18, 0x60, 0xC6, 0x06, 0x60, 0x18, 0x06,
    0x01, 0x80, 0x60, 0x18, 0x06, 0x01, 0x80, 0x60, 0x18, 0x07, 0xFD, 0xFF,
    0x70, 0x1C, 0xE0, 0x39, 0xE0, 0xF3, 0xC1, 0xE6, 0xC6, 0xCD, 0xDD, 0x99,
    0xB3, 0x31, 0xC6, 0x63, 0x8C, 0xC0, 0x19, 0x80, 0x33, 0x00, 0x60, 0x70,
    0x33, 0xC1, 0x9E, 0x0C, 0xF8, 0x66, 0xE3, 0x33, 0x19, 0x8C, 0xCC, 0x76,
    0x61, 0xF3, 0x07, 0x98, 0x1C, 0xC0, 0xE0, 0x0F, 0xC0, 0x7F, 0x83, 0x87,
    0x1C, 0x0E, 0x60, 0x19, 0x80, 0x66, 0x01, 0x98, 0x06, 0x70, 0x38, 0xE1,
    0xC1, 0xFE, 0x03, 0xF0, 0x7F, 0x0F, 0xF1, 0x87, 0x30, 0x66, 0x0C, 0xC3,
    0x9F, 0xE3, 0xF8, 0x60, 0x0C, 0x01, 0x80, 0x30, 0x00, 0x0F, 0xC0, 0x7F,
    0x83, 0x87, 0x1C, 0x0E, 0x60, 0x19, 0x80, 0x66, 0x01, 0x98, 0x06, 0x70,
    0x38, 0xE1, 0xC1, 0xFE, 0x03, 0xF0, 0x01, 0xC0, 0x01, 0xE0, 0x01, 0x80,
    0x7F, 0x0F, 0xF1, 0x87, 0x30, 0x66, 0x1C, 0xFF, 0x1F, 0xC3, 0x18, 0x61,
    0x8C, 0x39, 0x83, 0x30, 0x30, 0x1F, 0x87, 0xF1, 0xC0, 0x30, 0x07, 0x80,
    0x7E, 0x03, 0xF0, 0x0E, 0x00, 0xC0, 0x19, 0xFE, 0x1F, 0x80, 0xFF, 0xFF,
    0xF0, 0xC0, 0x30, 0x0C, 0x03, 0x00, 0xC0, 0x30, 0x0C, 0x03, 0x00, 0xC0,
    0x30, 0x60, 0x63, 0x03, 0x18, 0x18, 0xC0, 0xC6, 0x06, 0x30, 0x31, 0x81,
    0x8C, 0x0C, 0x60, 0x63, 0x87, 0x0F, 0xF0, 0x3F, 0x00, 0xC0, 0x36, 0x06,
    0x60, 0x67, 0x0E, 0x30, 0xC3, 0x0C, 0x19, 0x81, 0x98, 0x19, 0x80, 0xF0,
    0x0F, 0x00, 0x60, 0xC1, 0xC1, 0xF0, 0xE1, 0xD8, 0x70, 0xCC, 0x6C, 0x66,
    0x36, 0x31, 0x9B, 0x30, 0xC9, 0x98, 0x6C, 0x6C, 0x16, 0x34, 0x0F, 0x1E,
    0x07, 0x07, 0x03, 0x83, 0x80, 0xE0, 0xEC, 0x18, 0xC6, 0x0D, 0x81, 0xF0,
    0x1C, 0x03, 0x80, 0xD8, 0x3B, 0x86, 0x31, 0x83, 0x70, 0x70, 0xC0, 0xEC,
    0x19, 0xC6, 0x19, 0xC3, 0xB0, 0x3C, 0x03, 0x80, 0x60, 0x0C, 0x01, 0x80,
    0x30, 0x06, 0x00, 0x7F, 0xCF, 0xF8, 0x06, 0x00, 0xC0, 0x30, 0x0C, 0x03,
    0x00, 0xC0, 0x30, 0x06, 0x01, 0xFF, 0x3F, 0xE0, 0x7D, 0xF6, 0x18, 0x61,
    0x86, 0x18, 0x61, 0x86, 0x18, 0x61, 0x86, 0x1F, 0x7C, 0xC0, 0x30, 0x18,
    0x0C, 0x03, 0x01, 0x80, 0xE0, 0x30, 0x18, 0x0E, 0x03, 0x01, 0x80, 0x60,
    0x30, 0x18, 0x06, 0x03, 0x00, 0xFB, 0xE1, 0x86, 0x18, 0x61, 0x86, 0x18,
    0x61, 0x86, 0x18, 0x61, 0xBE, 0xF8, 0x0E, 0x01, 0xC0, 0x6C, 0x0D, 0x83,
    0x18, 0x63, 0x18, 0x30, 0x00, 0x00, 0x00, 0x00, 0x00, 0x00, 0x00, 0x00,
    0x7F, 0xFF, 0xE0, 0x0E, 0x00, 0xC0, 0x0C, 0x00, 0x00, 0x00, 0x00, 0x00,
    0x00, 0x00, 0x00, 0x00, 0x00, 0x00, 0x00, 0x00, 0x00, 0x00, 0x00, 0x3E,
    0x1F, 0x80, 0xC7, 0xE7, 0xF3, 0x19, 0x8C, 0xFE, 0x3B, 0x00, 0x60, 0x0C,
    0x01, 0x80, 0x30, 0x06, 0xF0, 0xFF, 0x18, 0x73, 0x06, 0x60, 0xCC, 0x19,
    0x87, 0x3F, 0xC6, 0xF0, 0x1F, 0x1F, 0x9C, 0x0C, 0x06, 0x03, 0x01, 0xC0,
    0x7E, 0x1F, 0x00, 0x01, 0x80, 0x60, 0x18, 0x06, 0x1D, 0x8F, 0xE7, 0x19,
    0x86, 0x61, 0x98, 0x67, 0x18, 0xFE, 0x1D, 0x80, 0x1F, 0x0F, 0xE6, 0x19,
    0xFE, 0x7F, 0x98, 0x07, 0x00, 0xFE, 0x1F, 0x80, 0x1E, 0x7C, 0xC1, 0x8F,
    0xFF, 0xCC, 0x18, 0x30, 0x60, 0xC1, 0x83, 0x00, 0x1D, 0x8F, 0xE7, 0x19,
    0x86, 0x61, 0x98, 0x67, 0x18, 0xFE, 0x1D, 0x80, 0x60, 0x38, 0xFC, 0x3E,
    0x00, 0x60, 0x18, 0x06, 0x01, 0x80, 0x6F, 0x1F, 0xE7, 0x19, 0x86, 0x61,
    0x98, 0x66, 0x19, 0x86, 0x61, 0x80, 0x66, 0x00, 0x66, 0x66, 0x66, 0x66,
    0x60, 0x31, 0x80, 0x03, 0x18, 0xC6, 0x31, 0x8C, 0x63, 0x18, 0xDE, 0xE0,
    0x60, 0x18, 0x06, 0x01, 0x80, 0x61, 0x98, 0xC6, 0x61, 0xB0, 0x78, 0x1B,
    0x06, 0x61, 0x8C, 0x61, 0x80, 0x61, 0x86, 0x18, 0x61, 0x86, 0x18, 0x61,
    0x86, 0x1E, 0x38, 0x6F, 0x3C, 0x7F, 0xFE, 0x61, 0x86, 0x61, 0x86, 0x61,
    0x86, 0x61, 0x86, 0x61, 0x86, 0x61, 0x86, 0x61, 0x86, 0x6F, 0x1F, 0xE7,
    0x19, 0x86, 0x61, 0x98, 0x66, 0x19, 0x86, 0x61, 0x80, 0x1F, 0x07, 0xF1,
    0xC7, 0x30, 0x66, 0x0C, 0xC1, 0x9C, 0x71, 0xFC, 0x1F, 0x00, 0x6F, 0x0F,
    0xF1, 0x87, 0x30, 0x66, 0x0C, 0xC1, 0x98, 0x73, 0xFC, 0x6F, 0x0C, 0x01,
    0x80, 0x30, 0x06, 0x00, 0x1E, 0xC7, 0xF9, 0xC3, 0x30, 0x66, 0x0C, 0xC1,
    0x9C, 0x31, 0xFE, 0x1E, 0xC0, 0x18, 0x03, 0x00, 0x60, 0x0C, 0x6E, 0xFD,
    0x83, 0x06, 0x0C, 0x18, 0x30, 0x60, 0x3F, 0x3F, 0x98, 0x0F, 0x03, 0xE0,
    0x78, 0x0C, 0xFE, 0x7E, 0x00, 0x30, 0x30, 0x30, 0xFE, 0xFE, 0x30, 0x30,
    0x30, 0x30, 0x30, 0x3E, 0x1E, 0x61, 0x98, 0x66, 0x19, 0x86, 0x61, 0x98,
    0x66, 0x19, 0xFE, 0x3D, 0x80, 0xC1, 0xB1, 0x98, 0xCC, 0x63, 0x61, 0xB0,
    0x50, 0x38, 0x1C, 0x00, 0xC3, 0x0D, 0x8C, 0x66, 0x79, 0x99, 0xE6, 0x24,
    0x90, 0xD3, 0xC3, 0xCF, 0x07, 0x38, 0x18, 0x60, 0xE3, 0xB1, 0x8D, 0x83,
    0x81, 0xC1, 0xF0, 0xD8, 0xC6, 0xC3, 0x80, 0xC1, 0xB1, 0x98, 0xCC, 0x63,
    0x61, 0xB0, 0xD8, 0x38, 0x1C, 0x04, 0x06, 0x0F, 0x07, 0x00, 0x7F, 0x3F,
    0x81, 0x81, 0xC1, 0xC1, 0xC0, 0xC0, 0xFE, 0x7F, 0x00, 0x0F, 0x1F, 0x18,
    0x18, 0x18, 0x18, 0x18, 0x78, 0x70, 0x18, 0x18, 0x18, 0x18, 0x18, 0x18,
    0x1F, 0x0F, 0x30, 0xC3, 0x0C, 0x30, 0xC3, 0x0C, 0x30, 0xC3, 0x0C, 0x30,
    0xC3, 0x0C, 0x30, 0xC0, 0xF0, 0xF8, 0x18, 0x18, 0x18, 0x18, 0x18, 0x1E,
    0x0E, 0x18, 0x18, 0x18, 0x18, 0x18, 0x18, 0xF8, 0xF0, 0x38, 0xCF, 0x99,
    0x9F, 0x31, 0xC0, 0x00, 0x00, 0x00, 0x00, 0x00, 0x00, 0x00, 0xFF, 0xFF,
    0xFF, 0xFF, 0xF0, 0x00, 0x00, 0x00, 0x00, 0x00, 0x00, 0x00, 0x00, 0x00,
    0x36, 0x36, 0x6C, 0x6C, 0x6C, 0x00, 0x00, 0x00, 0x00, 0x00, 0x00, 0x00,
    0x36, 0x36, 0x6C, 0x6C, 0x6C, 0x00, 0x00, 0x00, 0x00, 0x00, 0x00, 0x00,
    0x31, 0x98, 0xC6, 0x00, 0x00, 0x00, 0x00, 0x00, 0x30, 0xC3, 0x0E, 0x38,
    0xE3, 0x0C, 0x30
};

const GFXglyph AmazonEmber_Medium12pt7bGlyphs[] PROGMEM = {
    {0, 0, 0, 5, 0, 0}, // 0x20 ' '
    {0, 4, 12, 5, 0, -12}, // 0x21 '!'
    {6, 7, 12, 7, 0, -12}, // 0x22 '"'
    {17, 11, 12, 11, 0, -12}, // 0x23 '#'
    {34, 11, 16, 11, 0, -14}, // 0x24 '$'
    {56, 17, 12, 17, 0, -12}, // 0x25 '%'
    {82, 13, 12, 13, 0, -12}, // 0x26 '&'
    {102, 4, 12, 4, 0, -12}, // 0x27 '''
    {108, 6, 17, 6, 0, -14}, // 0x28 '('
    {121, 6, 17, 6, 0, -14}, // 0x29 ')'
    {134, 7, 12, 7, 0, -12}, // 0x2A '*'
    {145, 11, 10, 11, 0, -10}, // 0x2B '+'
    {159, 5, 5, 5, 0, -2}, // 0x2C ','
    {163, 7, 6, 7, 0, -6}, // 0x2D '-'
    {169, 5, 3, 5, 0, -3}, // 0x2E '.'
    {171, 9, 17, 9, 0, -14}, // 0x2F '/'
    {191, 11, 12, 11, 0, -12}, // 0x30 '0'
    {208, 11, 12, 11, 0, -12}, // 0x31 '1'
    {225, 11, 12, 11, 0, -12}, // 0x32 '2'
    {242, 11, 12, 11, 0, -12}, // 0x33 '3'
    {259, 11, 12, 11, 0, -12}, // 0x34 '4'
    {276, 11, 12, 11, 0, -12}, // 0x35 '5'
    {293, 11, 12, 11, 0, -12}, // 0x36 '6'
    {310, 11, 12, 11, 0, -12}, // 0x37 '7'
    {327, 11, 12, 11, 0, -12}, // 0x38 '8'
    {344, 11, 12, 11, 0, -12}, // 0x39 '9'
    {361, 5, 9, 5, 0, -9}, // 0x3A ':'
    {367, 5, 12, 5, 0, -9}, // 0x3B ';'
    {375, 11, 11, 11, 0, -11}, // 0x3C '<'
    {391, 11, 9, 11, 0, -9}, // 0x3D '='
    {404, 11, 11, 11, 0, -11}, // 0x3E '>'
    {420, 8, 12, 8, 0, -12}, // 0x3F '?'
    {432, 18, 16, 17, 0, -12}, // 0x40 '@'
    {468, 11, 12, 12, 0, -12}, // 0x41 'A'
    {485, 11, 12, 11, 0, -12}, // 0x42 'B'
    {502, 11, 12, 11, 0, -12}, // 0x43 'C'
    {519, 12, 12, 12, 0, -12}, // 0x44 'D'
    {537, 10, 12, 10, 0, -12}, // 0x45 'E'
    {552, 10, 12, 10, 0, -12}, // 0x46 'F'
    {567, 13, 12, 12, 0, -12}, // 0x47 'G'
    {587, 13, 12, 13, 0, -12}, // 0x48 'H'
    {607, 5, 12, 5, 0, -12}, // 0x49 'I'
    {615, 8, 12, 8, 0, -12}, // 0x4A 'J'
    {627, 12, 12, 12, 0, -12}, // 0x4B 'K'
    {645, 10, 12, 10, 0, -12}, // 0x4C 'L'
    {660, 15, 12, 15, 0, -12}, // 0x4D 'M'
    {683, 13, 12, 13, 0, -12}, // 0x4E 'N'
    {703, 14, 12, 14, 0, -12}, // 0x4F 'O'
    {724, 11, 12, 11, 0, -12}, // 0x50 'P'
    {741, 14, 15, 14, 0, -12}, // 0x51 'Q'
    {768, 11, 12, 11, 0, -12}, // 0x52 'R'
    {785, 11, 12, 10, 0, -12}, // 0x53 'S'
    {802, 10, 12, 11, 0, -12}, // 0x54 'T'
    {817, 13, 12, 13, 0, -12}, // 0x55 'U'
    {837, 12, 12, 12, 0, -12}, // 0x56 'V'
    {855, 17, 12, 17, 0, -12}, // 0x57 'W'
    {881, 11, 12, 11, 0, -12}, // 0x58 'X'
    {898, 11, 12, 11, 0, -12}, // 0x59 'Y'
    {915, 11, 12, 11, 0, -12}, // 0x5A 'Z'
    {932, 6, 17, 6, 0, -14}, // 0x5B '['
    {945, 9, 17, 9, 0, -14}, // 0x5C '\'
    {965, 6, 17, 6, 0, -14}, // 0x5D ']'
    {978, 11, 12, 11, 0, -12}, // 0x5E '^'
    {995, 9, 3, 9, 0, 0}, // 0x5F '_'
    {999, 11, 14, 11, 0, -14}, // 0x60 '`'
    {1019, 9, 9, 10, 0, -9}, // 0x61 'a'
    {1030, 11, 13, 11, 0, -13}, // 0x62 'b'
    {1048, 9, 9, 8, 0, -9}, // 0x63 'c'
    {1059, 10, 13, 11, 0, -13}, // 0x64 'd'
    {1076, 10, 9, 10, 0, -9}, // 0x65 'e'
    {1088, 7, 13, 7, 0, -13}, // 0x66 'f'
    {1100, 10, 13, 11, 0, -9}, // 0x67 'g'
    {1117, 10, 13, 11, 0, -13}, // 0x68 'h'
    {1134, 4, 13, 5, 0, -13}, // 0x69 'i'
    {1141, 5, 17, 5, -1, -13}, // 0x6A 'j'
    {1152, 10, 13, 10, 0, -13}, // 0x6B 'k'
    {1169, 6, 13, 5, 0, -13}, // 0x6C 'l'
    {1179, 16, 9, 16, 0, -9}, // 0x6D 'm'
    {1197, 10, 9, 11, 0, -9}, // 0x6E 'n'
    {1209, 11, 9, 11, 0, -9}, // 0x6F 'o'
    {1222, 11, 13, 11, 0, -9}, // 0x70 'p'
    {1240, 11, 13, 11, 0, -9}, // 0x71 'q'
    {1258, 7, 9, 7, 0, -9}, // 0x72 'r'
    {1266, 9, 9, 8, 0, -9}, // 0x73 's'
    {1277, 8, 12, 7, 0, -12}, // 0x74 't'
    {1289, 10, 9, 11, 0, -9}, // 0x75 'u'
    {1301, 9, 9, 9, 0, -9}, // 0x76 'v'
    {1312, 14, 9, 14, 0, -9}, // 0x77 'w'
    {1328, 9, 9, 9, 0, -9}, // 0x78 'x'
    {1339, 9, 13, 9, 0, -9}, // 0x79 'y'
    {1354, 9, 9, 9, 0, -9}, // 0x7A 'z'
    {1365, 8, 17, 7, 0, -14}, // 0x7B '{'
    {1382, 6, 18, 5, 0, -14}, // 0x7C '|'
    {1396, 8, 17, 7, -1, -14}, // 0x7D '}'
    {1413, 11, 9, 11, 0, -9}, // 0x7E '~'
    {1426, 18, 6, 18, 0, -6}, // 0x7F '—'
    {1440, 8, 12, 8, 0, -12}, // 0x80 '“'
    {1452, 8, 12, 8, 0, -12}, // 0x81 '”'
    {1464, 5, 12, 5, 0, -12}, // 0x82 '’'
    {1472, 18, 3, 18, 0, -3}, // 0x83 '…'
};

const GFXfont AmazonEmber_Medium12pt7b PROGMEM = {
    (uint8_t *)AmazonEmber_Medium12pt7bBitmaps,
    (GFXglyph *)AmazonEmber_Medium12pt7bGlyphs,
    0x20, 0x83,
    23
};

#endif // AMAZON_EMBER_MEDIUM_12PT7B_H
```

## src/AmazonEmber_Medium9pt7b.h
```c
#ifndef AMAZON_EMBER_MEDIUM_9PT7B_H
#define AMAZON_EMBER_MEDIUM_9PT7B_H

#include "gfxfont.h"

const uint8_t AmazonEmber_Medium9pt7bBitmaps[] PROGMEM = {
    0x66, 0x66, 0x64, 0x40, 0x66, 0x6D, 0xB6, 0xD2, 0x00, 0x00, 0x00, 0x00,
    0x00, 0x36, 0x36, 0x24, 0xFF, 0x24, 0x24, 0xFF, 0x6C, 0x48, 0x48, 0x10,
    0x10, 0x7C, 0xD2, 0x90, 0xD0, 0x70, 0x1C, 0x16, 0x12, 0x96, 0x7C, 0x10,
    0x10, 0x30, 0x82, 0x44, 0x12, 0x40, 0x92, 0x03, 0x30, 0x01, 0x30, 0x1A,
    0x40, 0x92, 0x0C, 0x90, 0x43, 0x00, 0x3C, 0x0C, 0xC1, 0x98, 0x32, 0x03,
    0x98, 0xF3, 0x33, 0x66, 0x38, 0xC3, 0x0F, 0xB8, 0x66, 0x64, 0x00, 0x00,
    0x00, 0x11, 0x88, 0xC6, 0x31, 0x8C, 0x63, 0x08, 0x61, 0x00, 0x43, 0x08,
    0x63, 0x18, 0xC6, 0x31, 0x88, 0xC4, 0x00, 0x10, 0xA9, 0xF1, 0x42, 0x80,
    0x00, 0x00, 0x00, 0x00, 0x10, 0x10, 0x10, 0xFE, 0x10, 0x10, 0x10, 0x00,
    0x66, 0xC8, 0x78, 0x00, 0x00, 0x66, 0x04, 0x18, 0x30, 0xC1, 0x82, 0x0C,
    0x18, 0x20, 0xC1, 0x82, 0x0C, 0x00, 0x38, 0x44, 0xC6, 0xC6, 0xC6, 0xC6,
    0xC6, 0xC6, 0x44, 0x38, 0x38, 0x78, 0x58, 0x18, 0x18, 0x18, 0x18, 0x18,
    0x18, 0x18, 0x78, 0x84, 0x06, 0x06, 0x0C, 0x18, 0x30, 0x20, 0x40, 0xFE,
    0xFE, 0x0C, 0x18, 0x20, 0x78, 0x06, 0x06, 0x06, 0x04, 0xF8, 0x06, 0x0E,
    0x1E, 0x16, 0x36, 0x26, 0x66, 0x7E, 0x06, 0x06, 0xFE, 0xC0, 0xC0, 0xC0,
    0xFC, 0x06, 0x06, 0x06, 0x06, 0xF8, 0x3C, 0x60, 0xC0, 0xC0, 0xFC, 0xC6,
    0xC6, 0xC6, 0x46, 0x3C, 0xFE, 0x06, 0x04, 0x0C, 0x0C, 0x18, 0x18, 0x10,
    0x30, 0x30, 0x7C, 0xC6, 0xC6, 0xC6, 0x7C, 0x4C, 0xC6, 0xC6, 0xC6, 0x7C,
    0x78, 0xC4, 0xC6, 0xC6, 0xC6, 0x7E, 0x06, 0x06, 0x0C, 0xF8, 0x66, 0x00,
    0x06, 0x60, 0x66, 0x00, 0x06, 0x6C, 0x80, 0x02, 0x0C, 0x30, 0x60, 0x30,
    0x0C, 0x02, 0x00, 0x7E, 0x00, 0x00, 0x7E, 0x00, 0x00, 0x00, 0x40, 0x30,
    0x0C, 0x06, 0x0C, 0x30, 0x40, 0x00, 0x7A, 0x30, 0xC3, 0x18, 0x82, 0x00,
    0x30, 0xC0, 0x07, 0xC0, 0x60, 0xC3, 0x01, 0x89, 0xF6, 0x64, 0x89, 0x32,
    0x24, 0x89, 0x93, 0x64, 0x67, 0x60, 0x80, 0x03, 0x00, 0x03, 0xE0, 0x1C,
    0x0E, 0x05, 0x06, 0xC2, 0x21, 0x11, 0xFC, 0x82, 0x41, 0x60, 0xC0, 0x7C,
    0x33, 0x19, 0x8C, 0xC7, 0xC3, 0x19, 0x8C, 0xC6, 0x63, 0x3F, 0x00, 0x1F,
    0x30, 0x60, 0x60, 0x60, 0x60, 0x60, 0x60, 0x30, 0x1F, 0x7E, 0x18, 0xC6,
    0x19, 0x86, 0x61, 0x98, 0x66, 0x19, 0x86, 0x63, 0x1F, 0x80, 0x7E, 0x60,
    0x60, 0x60, 0x7C, 0x60, 0x60, 0x60, 0x60, 0x7E, 0x7E, 0xC1, 0x83, 0x06,
    0x0F, 0x98, 0x30, 0x60, 0xC0, 0x1F, 0x0C, 0x06, 0x01, 0x80, 0x60, 0x19,
    0xE6, 0x19, 0x86, 0x31, 0x87, 0xC0, 0x61, 0x98, 0x66, 0x19, 0x86, 0x7F,
    0x98, 0x66, 0x19, 0x86, 0x61, 0x98, 0x60, 0x66, 0x66, 0x66, 0x66, 0x66,
    0x18, 0x61, 0x86, 0x18, 0x61, 0x86, 0x13, 0xC0, 0x61, 0x33, 0x1B, 0x0F,
    0x07, 0x03, 0xC1, 0xB0, 0xCC, 0x63, 0x31, 0xC0, 0x60, 0xC1, 0x83, 0x06,
    0x0C, 0x18, 0x30, 0x60, 0xFC, 0x60, 0xE7, 0x0E, 0x71, 0xE7, 0x96, 0x6B,
    0x66, 0xE6, 0x66, 0x66, 0x06, 0x60, 0x66, 0x06, 0x61, 0x9C, 0x67, 0x19,
    0xE6, 0x69, 0x9B, 0x66, 0x59, 0x9E, 0x63, 0x98, 0xE0, 0x1F, 0x06, 0x31,
    0x83, 0x30, 0x66, 0x0C, 0xC1, 0x98, 0x33, 0x06, 0x31, 0x83, 0xE0, 0x7E,
    0x31, 0x98, 0xCC, 0x66, 0x33, 0xF1, 0x80, 0xC0, 0x60, 0x30, 0x00, 0x1F,
    0x06, 0x31, 0x83, 0x30, 0x66, 0x0C, 0xC1, 0x98, 0x33, 0x06, 0x31, 0x83,
    0xE0, 0x0C, 0x00, 0x60, 0x7E, 0x31, 0x98, 0xCC, 0x66, 0x33, 0xF1, 0x98,
    0xC6, 0x63, 0x30, 0xC0, 0x3F, 0x30, 0x18, 0x0C, 0x03, 0x80, 0x70, 0x0C,
    0x06, 0x03, 0x3E, 0x00, 0xFF, 0x18, 0x18, 0x18, 0x18, 0x18, 0x18, 0x18,
    0x18, 0x18, 0x61, 0x98, 0x66, 0x19, 0x86, 0x61, 0x98, 0x66, 0x19, 0x86,
    0x23, 0x07, 0x80, 0xC1, 0xA0, 0x98, 0xCC, 0x62, 0x21, 0xB0, 0xD8, 0x28,
    0x1C, 0x0E, 0x00, 0xC7, 0x1E, 0x38, 0xD1, 0x44, 0xCA, 0x66, 0x53, 0x36,
    0xD0, 0xA2, 0x87, 0x1C, 0x38, 0xE0, 0xC6, 0x00, 0xC1, 0xB1, 0x8D, 0x83,
    0x81, 0xC0, 0xE0, 0xD8, 0x44, 0x63, 0x60, 0xC0, 0xC1, 0x98, 0x62, 0x30,
    0xC8, 0x1E, 0x03, 0x00, 0xC0, 0x30, 0x0C, 0x03, 0x00, 0x7F, 0x01, 0x81,
    0x80, 0x80, 0xC0, 0xC0, 0x40, 0x60, 0x60, 0x3F, 0x80, 0x7B, 0x18, 0xC6,
    0x31, 0x8C, 0x63, 0x18, 0xC7, 0x80, 0xC0, 0x81, 0x83, 0x02, 0x06, 0x0C,
    0x08, 0x18, 0x30, 0x30, 0x60, 0x40, 0xF1, 0x8C, 0x63, 0x18, 0xC6, 0x31,
    0x8C, 0x6F, 0x00, 0x10, 0x38, 0x28, 0x6C, 0x44, 0xC6, 0x00, 0x00, 0x00,
    0x00, 0x01, 0xFC, 0x18, 0x0C, 0x00, 0x00, 0x00, 0x00, 0x00, 0x00, 0x00,
    0x00, 0x3C, 0x06, 0x06, 0x3E, 0x66, 0x66, 0x3E, 0x60, 0x30, 0x18, 0x0F,
    0xC6, 0x33, 0x19, 0x8C, 0xC6, 0x62, 0x2F, 0x00, 0x3C, 0xC1, 0x83, 0x06,
    0x0C, 0x0F, 0x00, 0x03, 0x01, 0x80, 0xC7, 0xE6, 0x33, 0x19, 0x8C, 0xC6,
    0x63, 0x1F, 0x80, 0x3C, 0x66, 0x62, 0x7E, 0x60, 0x60, 0x3E, 0x3B, 0x19,
    0xF6, 0x31, 0x8C, 0x63, 0x00, 0x3F, 0x31, 0x98, 0xCC, 0x66, 0x33, 0x18,
    0xFC, 0x06, 0x02, 0x1E, 0x00, 0x60, 0x60, 0x60, 0x7C, 0x66, 0x66, 0x66,
    0x66, 0x66, 0x66, 0x66, 0x06, 0x66, 0x66, 0x66, 0x31, 0x80, 0x63, 0x18,
    0xC6, 0x31, 0x8C, 0x6E, 0x00, 0x60, 0x60, 0x60, 0x66, 0x6C, 0x78, 0x70,
    0x78, 0x6C, 0x66, 0x63, 0x18, 0xC6, 0x31, 0x8C, 0x63, 0x80, 0x5D, 0xC6,
    0x66, 0x66, 0x66, 0x66, 0x66, 0x66, 0x66, 0x66, 0x60, 0x5C, 0x66, 0x66,
    0x66, 0x66, 0x66, 0x66, 0x3E, 0x31, 0x98, 0xCC, 0x66, 0x33, 0x18, 0xF8,
    0x5E, 0x31, 0x98, 0xCC, 0x66, 0x33, 0x11, 0xF8, 0xC0, 0x60, 0x30, 0x00,
    0x3D, 0x31, 0x98, 0xCC, 0x66, 0x33, 0x18, 0xFC, 0x06, 0x03, 0x01, 0x80,
    0x5B, 0x18, 0xC6, 0x31, 0x80, 0x3C, 0xC1, 0x81, 0xC0, 0xC1, 0x9E, 0x00,
    0x61, 0x8F, 0x98, 0x61, 0x86, 0x18, 0x38, 0x66, 0x66, 0x66, 0x66, 0x66,
    0x66, 0x7E, 0xC6, 0x89, 0x13, 0x62, 0x87, 0x04, 0x00, 0xC4, 0x69, 0x49,
    0x29, 0x35, 0x62, 0xA8, 0x63, 0x0C, 0x60, 0xC6, 0xD8, 0xE1, 0xC3, 0x8D,
    0xB1, 0x80, 0xC6, 0x89, 0x93, 0x62, 0x87, 0x04, 0x08, 0x31, 0xC0, 0xFC,
    0x18, 0x61, 0x86, 0x18, 0x3F, 0x00, 0x3B, 0x18, 0xC6, 0x33, 0x0C, 0x63,
    0x18, 0xC3, 0x80, 0x66, 0x66, 0x66, 0x66, 0x66, 0x66, 0x66, 0xE1, 0x8C,
    0x63, 0x18, 0x66, 0x31, 0x8C, 0x6E, 0x00, 0xF2, 0x9E, 0x00, 0x00, 0x00,
    0x00, 0xFF, 0xFC, 0x00, 0x00, 0x00, 0x00, 0x00, 0x24, 0x49, 0xB3, 0x60,
    0x00, 0x00, 0x00, 0x00, 0x00, 0x24, 0xD9, 0xB2, 0x40, 0x00, 0x00, 0x00,
    0x00, 0x00, 0x26, 0x64, 0x00, 0x00, 0x00, 0x33, 0x18, 0xCC, 0x60
};

const GFXglyph AmazonEmber_Medium9pt7bGlyphs[] PROGMEM = {
    {0, 0, 0, 4, 0, 0}, // 0x20 ' '
    {0, 4, 10, 4, 0, -10}, // 0x21 '!'
    {5, 6, 10, 6, 0, -10}, // 0x22 '"'
    {13, 8, 10, 8, 0, -10}, // 0x23 '#'
    {23, 8, 14, 8, 0, -12}, // 0x24 '$'
    {37, 13, 10, 13, 0, -10}, // 0x25 '%'
    {54, 11, 10, 10, 0, -10}, // 0x26 '&'
    {68, 4, 10, 3, 0, -10}, // 0x27 '''
    {73, 5, 13, 5, 0, -11}, // 0x28 '('
    {82, 5, 13, 5, 0, -11}, // 0x29 ')'
    {91, 7, 10, 6, 0, -10}, // 0x2A '*'
    {100, 8, 8, 8, 0, -8}, // 0x2B '+'
    {108, 4, 4, 4, 0, -2}, // 0x2C ','
    {110, 6, 4, 6, 0, -4}, // 0x2D '-'
    {113, 4, 2, 4, 0, -2}, // 0x2E '.'
    {114, 7, 13, 7, 0, -11}, // 0x2F '/'
    {126, 8, 10, 8, 0, -10}, // 0x30 '0'
    {136, 8, 10, 8, 0, -10}, // 0x31 '1'
    {146, 8, 10, 8, 0, -10}, // 0x32 '2'
    {156, 8, 10, 8, 0, -10}, // 0x33 '3'
    {166, 8, 10, 8, 0, -10}, // 0x34 '4'
    {176, 8, 10, 8, 0, -10}, // 0x35 '5'
    {186, 8, 10, 8, 0, -10}, // 0x36 '6'
    {196, 8, 10, 8, 0, -10}, // 0x37 '7'
    {206, 8, 10, 8, 0, -10}, // 0x38 '8'
    {216, 8, 10, 8, 0, -10}, // 0x39 '9'
    {226, 4, 7, 4, 0, -7}, // 0x3A ':'
    {230, 4, 9, 4, 0, -7}, // 0x3B ';'
    {235, 8, 8, 8, 0, -8}, // 0x3C '<'
    {243, 8, 7, 8, 0, -7}, // 0x3D '='
    {250, 8, 8, 8, 0, -8}, // 0x3E '>'
    {258, 6, 10, 6, 0, -10}, // 0x3F '?'
    {266, 14, 12, 14, 0, -9}, // 0x40 '@'
    {287, 9, 10, 9, 0, -10}, // 0x41 'A'
    {299, 9, 10, 9, 0, -10}, // 0x42 'B'
    {311, 8, 10, 8, 0, -10}, // 0x43 'C'
    {321, 10, 10, 10, 0, -10}, // 0x44 'D'
    {334, 8, 10, 8, 0, -10}, // 0x45 'E'
    {344, 7, 10, 7, 0, -10}, // 0x46 'F'
    {353, 10, 10, 10, 0, -10}, // 0x47 'G'
    {366, 10, 10, 10, 0, -10}, // 0x48 'H'
    {379, 4, 10, 4, 0, -10}, // 0x49 'I'
    {384, 6, 10, 6, 0, -10}, // 0x4A 'J'
    {392, 9, 10, 9, 0, -10}, // 0x4B 'K'
    {404, 7, 10, 7, 0, -10}, // 0x4C 'L'
    {413, 12, 10, 12, 0, -10}, // 0x4D 'M'
    {428, 10, 10, 10, 0, -10}, // 0x4E 'N'
    {441, 11, 10, 11, 0, -10}, // 0x4F 'O'
    {455, 9, 10, 8, 0, -10}, // 0x50 'P'
    {467, 11, 12, 11, 0, -10}, // 0x51 'Q'
    {484, 9, 10, 9, 0, -10}, // 0x52 'R'
    {496, 9, 10, 8, 0, -10}, // 0x53 'S'
    {508, 8, 10, 8, 0, -10}, // 0x54 'T'
    {518, 10, 10, 10, 0, -10}, // 0x55 'U'
    {531, 9, 10, 9, 0, -10}, // 0x56 'V'
    {543, 13, 10, 13, 0, -10}, // 0x57 'W'
    {560, 9, 10, 9, 0, -10}, // 0x58 'X'
    {572, 10, 10, 9, 0, -10}, // 0x59 'Y'
    {585, 9, 10, 8, 0, -10}, // 0x5A 'Z'
    {597, 5, 13, 5, 0, -11}, // 0x5B '['
    {606, 7, 13, 7, 0, -11}, // 0x5C '\'
    {618, 5, 13, 5, 0, -11}, // 0x5D ']'
    {627, 8, 10, 8, 0, -10}, // 0x5E '^'
    {637, 7, 2, 7, 0, 0}, // 0x5F '_'
    {639, 8, 10, 8, 0, -10}, // 0x60 '`'
    {649, 8, 7, 7, 0, -7}, // 0x61 'a'
    {656, 9, 10, 8, 0, -10}, // 0x62 'b'
    {668, 7, 7, 7, 0, -7}, // 0x63 'c'
    {675, 9, 10, 8, 0, -10}, // 0x64 'd'
    {687, 8, 7, 7, 0, -7}, // 0x65 'e'
    {694, 5, 10, 5, 0, -10}, // 0x66 'f'
    {701, 9, 10, 8, 0, -7}, // 0x67 'g'
    {713, 8, 10, 8, 0, -10}, // 0x68 'h'
    {723, 4, 10, 4, 0, -10}, // 0x69 'i'
    {728, 5, 13, 4, -1, -10}, // 0x6A 'j'
    {737, 8, 10, 8, 0, -10}, // 0x6B 'k'
    {747, 5, 10, 4, 0, -10}, // 0x6C 'l'
    {754, 12, 7, 13, 0, -7}, // 0x6D 'm'
    {765, 8, 7, 8, 0, -7}, // 0x6E 'n'
    {772, 9, 7, 8, 0, -7}, // 0x6F 'o'
    {780, 9, 10, 8, 0, -7}, // 0x70 'p'
    {792, 9, 10, 8, 0, -7}, // 0x71 'q'
    {804, 5, 7, 5, 0, -7}, // 0x72 'r'
    {809, 7, 7, 6, 0, -7}, // 0x73 's'
    {816, 6, 9, 5, 0, -9}, // 0x74 't'
    {823, 8, 7, 8, 0, -7}, // 0x75 'u'
    {830, 7, 7, 7, 0, -7}, // 0x76 'v'
    {837, 11, 7, 11, 0, -7}, // 0x77 'w'
    {847, 7, 7, 7, 0, -7}, // 0x78 'x'
    {854, 7, 10, 7, 0, -7}, // 0x79 'y'
    {863, 7, 7, 7, 0, -7}, // 0x7A 'z'
    {870, 5, 13, 5, 0, -11}, // 0x7B '{'
    {879, 4, 14, 4, 0, -11}, // 0x7C '|'
    {886, 5, 13, 5, 0, -11}, // 0x7D '}'
    {895, 8, 6, 8, 0, -6}, // 0x7E '~'
    {901, 14, 4, 14, 0, -4}, // 0x7F '—'
    {908, 7, 10, 6, 0, -10}, // 0x80 '“'
    {917, 7, 10, 6, 0, -10}, // 0x81 '”'
    {926, 4, 10, 4, 0, -10}, // 0x82 '’'
    {931, 14, 2, 14, 0, -2}, // 0x83 '…'
};

const GFXfont AmazonEmber_Medium9pt7b PROGMEM = {
    (uint8_t *)AmazonEmber_Medium9pt7bBitmaps,
    (GFXglyph *)AmazonEmber_Medium9pt7bGlyphs,
    0x20, 0x83,
    18
};

#endif // AMAZON_EMBER_MEDIUM_9PT7B_H
```

## src/AtkinsonHyperlegibleNext9pt7b.h
```c
#pragma once
#include "GrayscaleFont.h"

const uint8_t AtkinsonHyperlegibleNext9pt7bBitmaps[] PROGMEM = {
    0x28, 0x28, 0x28, 0x28, 0x28, 0x14, 0x14, 0x00, 0x14, 0x28, 0x66, 0x66,
    0x65, 0x00, 0x00, 0x00, 0x00, 0x00, 0x00, 0x00, 0x03, 0x4C, 0x00, 0xC3,
    0x00, 0x31, 0xC0, 0xFF, 0xFE, 0x06, 0x28, 0x02, 0x89, 0x07, 0xFF, 0xF0,
    0x34, 0xD0, 0x0D, 0x30, 0x03, 0x0C, 0x00, 0x00, 0x00, 0x01, 0x40, 0x0B,
    0xE4, 0x39, 0xAC, 0x31, 0x40, 0x39, 0x40, 0x1F, 0x90, 0x01, 0xBC, 0x01,
    0x4A, 0x21, 0x4A, 0x39, 0x9D, 0x0B, 0xE4, 0x01, 0x40, 0x00, 0x00, 0x1F,
    0x40, 0x70, 0x1D, 0x74, 0x34, 0x06, 0x0A, 0x28, 0x01, 0xD3, 0x5C, 0x00,
    0x1F, 0x8D, 0x00, 0x00, 0x0A, 0x2F, 0x40, 0x07, 0x18, 0x70, 0x03, 0x49,
    0x09, 0x01, 0x81, 0x87, 0x00, 0xC0, 0x2F, 0x40, 0x02, 0xF4, 0x00, 0x28,
    0x70, 0x00, 0xA0, 0xC0, 0x01, 0xDA, 0x00, 0x07, 0xE0, 0x00, 0xB6, 0xCA,
    0x03, 0x42, 0xF4, 0x0C, 0x02, 0xC0, 0x29, 0x1F, 0x80, 0x2F, 0x83, 0x80,
    0x66, 0x60, 0x00, 0x00, 0x00, 0x09, 0x0C, 0x18, 0x24, 0x30, 0x30, 0x70,
    0x30, 0x30, 0x34, 0x28, 0x0C, 0x09, 0x70, 0x24, 0x18, 0x0C, 0x0C, 0x09,
    0x09, 0x0C, 0x0C, 0x18, 0x24, 0x70, 0x02, 0x00, 0x9D, 0x41, 0xB8, 0x03,
    0x60, 0x04, 0x40, 0x00, 0x00, 0x00, 0x00, 0x00, 0x00, 0x00, 0x00, 0x00,
    0x01, 0x80, 0x01, 0x80, 0x01, 0x80, 0x7F, 0xFE, 0x01, 0x80, 0x01, 0x80,
    0x01, 0x80, 0x21, 0xD2, 0x04, 0xBF, 0x80, 0x00, 0x00, 0x00, 0x21, 0xC0,
    0x01, 0xC0, 0x28, 0x03, 0x40, 0x30, 0x0A, 0x00, 0xD0, 0x0C, 0x02, 0x80,
    0x34, 0x03, 0x00, 0xA0, 0x00, 0x00, 0x06, 0xE4, 0x07, 0x47, 0x42, 0xD0,
    0x70, 0xDC, 0x0C, 0x31, 0x83, 0x0C, 0x24, 0xC3, 0x43, 0x70, 0xA0, 0x7C,
    0x1D, 0x1D, 0x01, 0xB9, 0x00, 0x07, 0x07, 0xF0, 0x17, 0x00, 0x30, 0x03,
    0x00, 0x30, 0x03, 0x00, 0x30, 0x03, 0x00, 0x30, 0x0B, 0xE0, 0x38, 0x78,
    0x20, 0x1C, 0x00, 0x28, 0x00, 0x34, 0x00, 0xA0, 0x02, 0x80, 0x0A, 0x00,
    0x78, 0x00, 0xBF, 0xFC, 0x0B, 0xE0, 0x38, 0x28, 0x10, 0x1C, 0x00, 0x68,
    0x03, 0xE0, 0x00, 0x68, 0x00, 0x0C, 0x20, 0x0C, 0x38, 0x28, 0x1B, 0xE0,
    0x00, 0x74, 0x00, 0x3D, 0x00, 0x27, 0x40, 0x28, 0xD0, 0x1C, 0x34, 0x0D,
    0x0D, 0x07, 0xFF, 0xF0, 0x00, 0xD0, 0x00, 0x34, 0x00, 0x0D, 0x00, 0x1F,
    0xFC, 0x28, 0x00, 0x24, 0x00, 0x2B, 0xE0, 0x38, 0x28, 0x00, 0x0C, 0x00,
    0x0D, 0x20, 0x0C, 0x28, 0x28, 0x0B, 0xE0, 0x06, 0xE4, 0x1D, 0x18, 0x24,
    0x00, 0x36, 0xE4, 0x3D, 0x2C, 0x34, 0x0D, 0x34, 0x0A, 0x24, 0x0D, 0x1D,
    0x2C, 0x07, 0xE0, 0xBF, 0xF8, 0x00, 0xD0, 0x07, 0x00, 0x28, 0x00, 0xC0,
    0x0A, 0x00, 0x34, 0x02, 0xC0, 0x0D, 0x00, 0x70, 0x00, 0x06, 0xE0, 0x03,
    0x5A, 0x01, 0xC1, 0x80, 0x34, 0xA0, 0x0B, 0xF4, 0x0A, 0x47, 0x43, 0x40,
    0xA0, 0xD0, 0x28, 0x28, 0x1D, 0x02, 0xF9, 0x00, 0x07, 0xE0, 0x2D, 0x6C,
    0x34, 0x0D, 0x30, 0x09, 0x34, 0x0D, 0x2D, 0x6C, 0x07, 0xF4, 0x00, 0x70,
    0x00, 0xD0, 0x02, 0x80, 0x70, 0x80, 0x00, 0x00, 0x87, 0x00, 0x70, 0x80,
    0x00, 0x00, 0x87, 0x48, 0x10, 0x00, 0x18, 0x01, 0xB8, 0x1F, 0x40, 0x78,
    0x00, 0x1F, 0x40, 0x01, 0xB8, 0x00, 0x18, 0x00, 0x00, 0x0F, 0xFF, 0xC0,
    0x00, 0x00, 0xFF, 0xFC, 0x00, 0x00, 0x00, 0x00, 0x00, 0x60, 0x00, 0x2E,
    0x40, 0x02, 0xE4, 0x00, 0x2C, 0x02, 0xE4, 0x2E, 0x40, 0x60, 0x00, 0x1F,
    0xD1, 0xD1, 0xD1, 0x03, 0x40, 0x1C, 0x01, 0xD0, 0x1D, 0x00, 0xA0, 0x00,
    0x00, 0x05, 0x00, 0x28, 0x00, 0x01, 0xA9, 0x00, 0x29, 0x1A, 0x01, 0x80,
    0x0A, 0x0C, 0x2F, 0x4C, 0x62, 0x49, 0x21, 0x8C, 0x24, 0x92, 0x34, 0xE3,
    0x08, 0x7D, 0xB4, 0x0D, 0x00, 0x00, 0x0A, 0xE4, 0x00, 0x02, 0xD0, 0x00,
    0xF8, 0x00, 0x77, 0x00, 0x28, 0xD0, 0x0D, 0x28, 0x07, 0x07, 0x02, 0x80,
    0xD0, 0xFF, 0xF8, 0x70, 0x07, 0x28, 0x00, 0xD0, 0x3F, 0xF8, 0x0D, 0x07,
    0x43, 0x40, 0xA0, 0xD0, 0x74, 0x3F, 0xF8, 0x0D, 0x02, 0x83, 0x40, 0x70,
    0xD0, 0x1C, 0x34, 0x1E, 0x0F, 0xFE, 0x00, 0x02, 0xF8, 0x07, 0x96, 0xC3,
    0x80, 0x10, 0xC0, 0x00, 0x70, 0x00, 0x1C, 0x00, 0x03, 0x00, 0x00, 0xE0,
    0x04, 0x1E, 0x1B, 0x01, 0xBE, 0x00, 0x3F, 0xE4, 0x0D, 0x17, 0x83, 0x40,
    0x74, 0xD0, 0x0A, 0x34, 0x02, 0x8D, 0x00, 0xA3, 0x40, 0x28, 0xD0, 0x1D,
    0x34, 0x1E, 0x0F, 0xF9, 0x00, 0x3F, 0xFD, 0x34, 0x00, 0x34, 0x00, 0x34,
    0x00, 0x3F, 0xF0, 0x34, 0x00, 0x34, 0x00, 0x34, 0x00, 0x34, 0x00, 0x3F,
    0xFD, 0x3F, 0xFC, 0x34, 0x00, 0x34, 0x00, 0x34, 0x00, 0x3F, 0xFC, 0x34,
    0x00, 0x34, 0x00, 0x34, 0x00, 0x34, 0x00, 0x34, 0x00, 0x02, 0xF8, 0x01,
    0xE5, 0xB0, 0x28, 0x01, 0x03, 0x00, 0x00, 0x70, 0x00, 0x07, 0x03, 0xFC,
    0x30, 0x01, 0xC3, 0x80, 0x2C, 0x1E, 0x0B, 0xC0, 0x6F, 0x8C, 0x34, 0x02,
    0x83, 0x40, 0x28, 0x34, 0x02, 0x83, 0x40, 0x28, 0x3F, 0xFF, 0x83, 0x40,
    0x28, 0x34, 0x02, 0x83, 0x40, 0x28, 0x34, 0x02, 0x83, 0x40, 0x28, 0x7F,
    0x83, 0x40, 0xD0, 0x34, 0x0D, 0x03, 0x40, 0xD0, 0x34, 0x0D, 0x1F, 0xE0,
    0x00, 0x70, 0x01, 0xC0, 0x07, 0x00, 0x1C, 0x00, 0x70, 0x01, 0xC0, 0x07,
    0x28, 0x1C, 0x74, 0xA0, 0xBE, 0x00, 0x34, 0x0A, 0x0D, 0x0B, 0x03, 0x47,
    0x00, 0xD7, 0x40, 0x3B, 0xC0, 0x0F, 0xB8, 0x03, 0x87, 0x40, 0xD0, 0xB0,
    0x34, 0x0E, 0x0D, 0x01, 0xD0, 0x34, 0x00, 0x34, 0x00, 0x34, 0x00, 0x34,
    0x00, 0x34, 0x00, 0x34, 0x00, 0x34, 0x00, 0x34, 0x00, 0x34, 0x00, 0x3F,
    0xFD, 0x3D, 0x00, 0xF4, 0x3E, 0x01, 0xF4, 0x3B, 0x01, 0xB4, 0x37, 0x42,
    0x74, 0x36, 0x83, 0x34, 0x35, 0xC7, 0x34, 0x34, 0xDA, 0x34, 0x34, 0xAD,
    0x34, 0x34, 0x7C, 0x34, 0x34, 0x38, 0x34, 0x3D, 0x02, 0x83, 0xE0, 0x28,
    0x37, 0x42, 0x83, 0x68, 0x28, 0x34, 0xD2, 0x83, 0x4A, 0x28, 0x34, 0x36,
    0x83, 0x42, 0xA8, 0x34, 0x0F, 0x83, 0x40, 0xB8, 0x02, 0xF8, 0x01, 0xE5,
    0xB4, 0x28, 0x02, 0x83, 0x00, 0x1C, 0x70, 0x00, 0xD7, 0x00, 0x0D, 0x30,
    0x01, 0xC2, 0x80, 0x28, 0x1E, 0x5B, 0x40, 0x2F, 0x80, 0x3F, 0xF8, 0x34,
    0x1E, 0x34, 0x0A, 0x34, 0x0A, 0x34, 0x1E, 0x3F, 0xF8, 0x34, 0x00, 0x34,
    0x00, 0x34, 0x00, 0x34, 0x00, 0x02, 0xF8, 0x00, 0x79, 0x6D, 0x02, 0x80,
    0x28, 0x0C, 0x00, 0x70, 0x70, 0x00, 0xD1, 0xC1, 0xD3, 0x43, 0x02, 0xEC,
    0x0A, 0x02, 0xF0, 0x1E, 0x4B, 0xD0, 0x0B, 0xE5, 0xC0, 0x00, 0x01, 0x00,
    0x3F, 0xF8, 0x0D, 0x07, 0x83, 0x40, 0x70, 0xD0, 0x1C, 0x34, 0x1E, 0x0F,
    0xFE, 0x03, 0x4A, 0x00, 0xD0, 0xD0, 0x34, 0x1D, 0x0D, 0x02, 0xC0, 0x0B,
    0xE4, 0x39, 0x6C, 0x30, 0x00, 0x38, 0x00, 0x1F, 0x90, 0x01, 0xBC, 0x00,
    0x0E, 0x20, 0x0A, 0x39, 0x1D, 0x0B, 0xE4, 0xFF, 0xFE, 0x02, 0x80, 0x02,
    0x80, 0x02, 0x80, 0x02, 0x80, 0x02, 0x80, 0x02, 0x80, 0x02, 0x80, 0x02,
    0x80, 0x02, 0x80, 0x34, 0x02, 0x83, 0x40, 0x28, 0x34, 0x02, 0x83, 0x40,
    0x28, 0x34, 0x02, 0x83, 0x40, 0x28, 0x34, 0x02, 0x82, 0x80, 0x34, 0x1D,
    0x1B, 0x00, 0x6F, 0x80, 0xA0, 0x07, 0x1C, 0x02, 0x83, 0x40, 0xD0, 0xA0,
    0x70, 0x1C, 0x28, 0x03, 0x4D, 0x00, 0xA7, 0x00, 0x1E, 0x80, 0x03, 0xD0,
    0x00, 0xB0, 0x00, 0xA0, 0x3C, 0x0E, 0x70, 0x3C, 0x0D, 0x34, 0x6D, 0x1C,
    0x34, 0x69, 0x1C, 0x28, 0x96, 0x28, 0x1C, 0xC3, 0x34, 0x1D, 0xC3, 0x74,
    0x0E, 0x82, 0xB0, 0x0B, 0x42, 0xE0, 0x0B, 0x41, 0xD0, 0x74, 0x0B, 0x0B,
    0x07, 0x40, 0xE3, 0x80, 0x1E, 0xC0, 0x02, 0xD0, 0x00, 0xF8, 0x00, 0xB7,
    0x40, 0x74, 0xB0, 0x38, 0x0E, 0x2C, 0x01, 0xD0, 0xA0, 0x0A, 0x0D, 0x03,
    0x42, 0x82, 0x80, 0x35, 0xC0, 0x0B, 0xA0, 0x00, 0xF0, 0x00, 0x28, 0x00,
    0x0A, 0x00, 0x02, 0x80, 0x00, 0xA0, 0x00, 0x3F, 0xFE, 0x00, 0x07, 0x40,
    0x02, 0x80, 0x02, 0xC0, 0x01, 0xD0, 0x00, 0xE0, 0x00, 0xB0, 0x00, 0x70,
    0x00, 0x38, 0x00, 0x1F, 0xFF, 0xC0, 0x3F, 0x34, 0x34, 0x34, 0x34, 0x34,
    0x34, 0x34, 0x34, 0x34, 0x34, 0x34, 0x3F, 0xA0, 0x07, 0x00, 0x34, 0x02,
    0x80, 0x1C, 0x00, 0xD0, 0x0A, 0x00, 0x70, 0x03, 0x40, 0x28, 0x01, 0xC0,
    0x00, 0x3E, 0x01, 0x80, 0x60, 0x18, 0x06, 0x01, 0x80, 0x60, 0x18, 0x06,
    0x01, 0x80, 0x60, 0x18, 0x3E, 0x00, 0x03, 0x80, 0x07, 0xC0, 0x0D, 0xA0,
    0x18, 0x34, 0x34, 0x28, 0x00, 0x00, 0x00, 0x00, 0x00, 0x00, 0x00, 0x00,
    0x00, 0x00, 0x3F, 0xF4, 0x00, 0x00, 0x55, 0x59, 0x40, 0x54, 0x41, 0x51,
    0x11, 0x41, 0x45, 0x04, 0x14, 0x44, 0x51, 0x05, 0x50, 0x15, 0x55, 0x60,
    0x0B, 0xD0, 0x91, 0xC0, 0x03, 0x46, 0xAD, 0x70, 0x35, 0xC1, 0xD2, 0xFA,
    0x40, 0x30, 0x00, 0x30, 0x00, 0x30, 0x00, 0x36, 0xE0, 0x38, 0x2C, 0x34,
    0x0D, 0x30, 0x0D, 0x34, 0x0D, 0x38, 0x2C, 0x36, 0xE0, 0x0B, 0x90, 0xE1,
    0x87, 0x00, 0x18, 0x00, 0x70, 0x00, 0xE1, 0x80, 0xB9, 0x00, 0x00, 0x1C,
    0x00, 0x1C, 0x00, 0x1C, 0x0B, 0x9C, 0x38, 0x7C, 0x70, 0x1C, 0x70, 0x1C,
    0x70, 0x1C, 0x38, 0x3C, 0x0B, 0x9C, 0x0B, 0xD0, 0x38, 0x24, 0x70, 0x1C,
    0x7F, 0xFC, 0x70, 0x00, 0x38, 0x24, 0x0B, 0xE0, 0x1F, 0x28, 0x28, 0xBF,
    0x28, 0x28, 0x28, 0x28, 0x28, 0x28, 0x1B, 0x9C, 0x38, 0x7C, 0x70, 0x1C,
    0x60, 0x1C, 0x70, 0x1C, 0x38, 0x7C, 0x0B, 0x9C, 0x00, 0x18, 0x28, 0x74,
    0x0B, 0xE0, 0x30, 0x00, 0x30, 0x00, 0x30, 0x00, 0x36, 0xE0, 0x38, 0x38,
    0x34, 0x28, 0x30, 0x18, 0x30, 0x18, 0x30, 0x18, 0x30, 0x18, 0x34, 0x24,
    0x00, 0xB4, 0x24, 0x24, 0x24, 0x24, 0x24, 0x24, 0x09, 0x09, 0x00, 0x09,
    0x09, 0x09, 0x09, 0x09, 0x09, 0x09, 0x09, 0x0D, 0xF8, 0x30, 0x00, 0xC0,
    0x03, 0x00, 0x0C, 0x1C, 0x31, 0xC0, 0xDD, 0x03, 0xF4, 0x0D, 0x70, 0x30,
    0xA0, 0xC0, 0xD0, 0x30, 0x30, 0x30, 0x30, 0x30, 0x30, 0x30, 0x30, 0x34,
    0x2D, 0x36, 0xE2, 0xE0, 0x38, 0x7D, 0x28, 0x34, 0x28, 0x18, 0x30, 0x28,
    0x1C, 0x30, 0x28, 0x1C, 0x30, 0x28, 0x1C, 0x30, 0x28, 0x1C, 0x36, 0xE0,
    0x38, 0x38, 0x34, 0x28, 0x30, 0x18, 0x30, 0x18, 0x30, 0x18, 0x30, 0x18,
    0x0B, 0xD0, 0x38, 0x78, 0x70, 0x1C, 0x60, 0x0C, 0x70, 0x1C, 0x38, 0x38,
    0x0B, 0xE0, 0x36, 0xE0, 0x38, 0x2C, 0x34, 0x0D, 0x30, 0x0D, 0x34, 0x0D,
    0x38, 0x2C, 0x36, 0xE0, 0x30, 0x00, 0x30, 0x00, 0x30, 0x00, 0x0B, 0x9C,
    0x0E, 0x1F, 0x07, 0x01, 0xC1, 0xC0, 0x70, 0x70, 0x1C, 0x0E, 0x0F, 0x00,
    0xB9, 0xC0, 0x00, 0x70, 0x00, 0x0D, 0x00, 0x02, 0xE0, 0x32, 0x8F, 0x53,
    0x40, 0xD0, 0x30, 0x0C, 0x03, 0x00, 0x1F, 0x81, 0xD1, 0x47, 0x40, 0x06,
    0xE4, 0x00, 0x71, 0xD1, 0xC1, 0xB9, 0x00, 0x14, 0x0A, 0x0B, 0xF0, 0xA0,
    0x28, 0x0A, 0x02, 0x80, 0xA0, 0x1F, 0x00, 0x30, 0x28, 0x30, 0x28, 0x30,
    0x28, 0x30, 0x28, 0x34, 0x38, 0x38, 0x78, 0x1F, 0x98, 0xA0, 0x31, 0xC1,
    0x83, 0x49, 0x0A, 0x30, 0x1D, 0x80, 0x3D, 0x00, 0xB0, 0x00, 0xA0, 0xE0,
    0xD7, 0x1E, 0x1C, 0x31, 0x72, 0x82, 0x66, 0x64, 0x2B, 0x1B, 0x01, 0xE0,
    0xE0, 0x0D, 0x0E, 0x00, 0x70, 0x70, 0xA3, 0x40, 0xF8, 0x02, 0xD0, 0x0E,
    0x80, 0xA3, 0x8B, 0x03, 0x40, 0xA0, 0x71, 0xC2, 0x83, 0x0D, 0x09, 0x30,
    0x19, 0x80, 0x39, 0x00, 0xB0, 0x01, 0xC0, 0x09, 0x01, 0xE0, 0x00, 0x7F,
    0xF0, 0x03, 0x80, 0x28, 0x01, 0xC0, 0x1C, 0x00, 0xD0, 0x07, 0xFF, 0x00,
    0x0B, 0x43, 0x00, 0xC0, 0x30, 0x0C, 0x07, 0x07, 0x40, 0x70, 0x0C, 0x03,
    0x00, 0xC0, 0x30, 0x0B, 0x40, 0x34, 0xD3, 0x4D, 0x34, 0xD3, 0x4D, 0x34,
    0xD3, 0x4D, 0x34, 0xD0, 0xB8, 0x07, 0x01, 0xC0, 0x70, 0x1C, 0x03, 0x40,
    0x74, 0x34, 0x1C, 0x07, 0x01, 0xC0, 0x70, 0xB8, 0x00, 0x00, 0x00, 0x2A,
    0x4C, 0x61, 0xB8, 0x00, 0x00, 0x00, 0x00, 0x00, 0x00, 0x7F, 0xFF, 0xF8,
    0x00, 0x00, 0x00, 0x00, 0x00, 0x00, 0x00, 0x00, 0x00, 0x15, 0x82, 0x24,
    0x37, 0x82, 0x64, 0x00, 0x00, 0x00, 0x00, 0x00, 0x00, 0x00, 0x00, 0x00,
    0x36, 0x83, 0x68, 0x21, 0x41, 0x10, 0x00, 0x00, 0x00, 0x00, 0x00, 0x00,
    0x00, 0x00, 0x00, 0x34, 0xD2, 0x04, 0x00, 0x00, 0x00, 0x00, 0x00, 0x20,
    0x92, 0x5C, 0x34, 0xA0
};

const GrayscaleGlyph AtkinsonHyperlegibleNext9pt7bGlyphs[] PROGMEM = {
    {0, 0, 0, 4, 0, 0}, // 0x20 ' '
    {0, 4, 10, 4, 0, -10}, // 0x21 '!'
    {10, 4, 10, 4, 0, -10}, // 0x22 '"'
    {20, 9, 10, 9, 0, -10}, // 0x23 '#'
    {43, 8, 14, 8, 0, -12}, // 0x24 '$'
    {71, 13, 10, 13, 0, -10}, // 0x25 '%'
    {104, 11, 10, 10, 0, -10}, // 0x26 '&'
    {132, 2, 10, 2, 0, -10}, // 0x27 '''
    {137, 4, 13, 4, 0, -10}, // 0x28 '('
    {150, 4, 12, 4, 0, -10}, // 0x29 ')'
    {162, 7, 10, 7, 0, -10}, // 0x2A '*'
    {180, 8, 7, 8, 0, -7}, // 0x2B '+'
    {194, 3, 4, 3, 0, -2}, // 0x2C ','
    {197, 5, 4, 5, 0, -4}, // 0x2D '-'
    {202, 3, 2, 3, 0, -2}, // 0x2E '.'
    {204, 6, 12, 5, 0, -10}, // 0x2F '/'
    {222, 9, 10, 9, 0, -10}, // 0x30 '0'
    {245, 6, 10, 6, 0, -10}, // 0x31 '1'
    {260, 8, 10, 8, 0, -10}, // 0x32 '2'
    {280, 8, 10, 8, 0, -10}, // 0x33 '3'
    {300, 9, 10, 9, 0, -10}, // 0x34 '4'
    {323, 8, 10, 8, 0, -10}, // 0x35 '5'
    {343, 8, 10, 8, 0, -10}, // 0x36 '6'
    {363, 7, 10, 7, 0, -10}, // 0x37 '7'
    {381, 9, 10, 9, 0, -10}, // 0x38 '8'
    {404, 8, 10, 8, 0, -10}, // 0x39 '9'
    {424, 3, 7, 3, 0, -7}, // 0x3A ':'
    {430, 3, 9, 3, 0, -7}, // 0x3B ';'
    {437, 8, 7, 8, 0, -7}, // 0x3C '<'
    {451, 9, 6, 9, 0, -6}, // 0x3D '='
    {465, 8, 7, 8, 0, -7}, // 0x3E '>'
    {479, 7, 10, 7, 0, -10}, // 0x3F '?'
    {497, 11, 10, 11, 0, -9}, // 0x40 '@'
    {525, 9, 10, 9, 0, -10}, // 0x41 'A'
    {548, 9, 10, 9, 0, -10}, // 0x42 'B'
    {571, 9, 10, 9, 0, -10}, // 0x43 'C'
    {594, 9, 10, 9, 0, -10}, // 0x44 'D'
    {617, 8, 10, 8, 0, -10}, // 0x45 'E'
    {637, 8, 10, 8, 0, -10}, // 0x46 'F'
    {657, 10, 10, 10, 0, -10}, // 0x47 'G'
    {682, 10, 10, 10, 0, -10}, // 0x48 'H'
    {707, 5, 10, 5, 0, -10}, // 0x49 'I'
    {720, 7, 10, 7, 0, -10}, // 0x4A 'J'
    {738, 9, 10, 9, 0, -10}, // 0x4B 'K'
    {761, 8, 10, 8, 0, -10}, // 0x4C 'L'
    {781, 12, 10, 12, 0, -10}, // 0x4D 'M'
    {811, 10, 10, 10, 0, -10}, // 0x4E 'N'
    {836, 10, 10, 10, 0, -10}, // 0x4F 'O'
    {861, 8, 10, 8, 0, -10}, // 0x50 'P'
    {881, 11, 11, 10, 0, -10}, // 0x51 'Q'
    {912, 9, 10, 9, 0, -10}, // 0x52 'R'
    {935, 8, 10, 8, 0, -10}, // 0x53 'S'
    {955, 8, 10, 8, 0, -10}, // 0x54 'T'
    {975, 10, 10, 10, 0, -10}, // 0x55 'U'
    {1000, 9, 10, 8, 0, -10}, // 0x56 'V'
    {1023, 12, 10, 12, 0, -10}, // 0x57 'W'
    {1053, 9, 10, 9, 0, -10}, // 0x58 'X'
    {1076, 9, 10, 8, 0, -10}, // 0x59 'Y'
    {1099, 9, 10, 9, 0, -10}, // 0x5A 'Z'
    {1122, 4, 13, 4, 0, -10}, // 0x5B '['
    {1135, 6, 12, 5, 0, -10}, // 0x5C '\'
    {1153, 5, 13, 5, 0, -10}, // 0x5D ']'
    {1170, 8, 10, 8, 0, -10}, // 0x5E '^'
    {1190, 7, 2, 5, -1, 0}, // 0x5F '_'
    {1194, 7, 10, 7, 0, -10}, // 0x60 '`'
    {1212, 7, 7, 7, 0, -7}, // 0x61 'a'
    {1225, 8, 10, 8, 0, -10}, // 0x62 'b'
    {1245, 7, 7, 7, 0, -7}, // 0x63 'c'
    {1258, 8, 10, 8, 0, -10}, // 0x64 'd'
    {1278, 8, 7, 8, 0, -7}, // 0x65 'e'
    {1292, 4, 10, 4, 0, -10}, // 0x66 'f'
    {1302, 8, 10, 8, 0, -7}, // 0x67 'g'
    {1322, 8, 10, 8, 0, -10}, // 0x68 'h'
    {1342, 4, 10, 4, 0, -10}, // 0x69 'i'
    {1352, 4, 13, 3, -1, -10}, // 0x6A 'j'
    {1365, 7, 10, 7, 0, -10}, // 0x6B 'k'
    {1383, 4, 10, 4, 0, -10}, // 0x6C 'l'
    {1393, 12, 7, 12, 0, -7}, // 0x6D 'm'
    {1414, 8, 7, 8, 0, -7}, // 0x6E 'n'
    {1428, 8, 7, 8, 0, -7}, // 0x6F 'o'
    {1442, 8, 10, 8, 0, -7}, // 0x70 'p'
    {1462, 9, 10, 8, 0, -7}, // 0x71 'q'
    {1485, 5, 7, 5, 0, -7}, // 0x72 'r'
    {1494, 7, 7, 7, 0, -7}, // 0x73 's'
    {1507, 5, 9, 5, 0, -9}, // 0x74 't'
    {1519, 8, 7, 8, 0, -7}, // 0x75 'u'
    {1533, 7, 7, 6, 0, -7}, // 0x76 'v'
    {1546, 10, 7, 10, 0, -7}, // 0x77 'w'
    {1564, 7, 7, 7, 0, -7}, // 0x78 'x'
    {1577, 7, 10, 6, 0, -7}, // 0x79 'y'
    {1595, 7, 7, 6, 0, -7}, // 0x7A 'z'
    {1608, 5, 13, 5, 0, -10}, // 0x7B '{'
    {1625, 3, 14, 3, 0, -11}, // 0x7C '|'
    {1636, 5, 13, 5, 0, -10}, // 0x7D '}'
    {1653, 8, 6, 8, 0, -6}, // 0x7E '~'
    {1665, 12, 4, 12, 0, -4}, // 0x7F '—'
    {1677, 6, 10, 6, 0, -10}, // 0x80 '“'
    {1692, 6, 10, 6, 0, -10}, // 0x81 '”'
    {1707, 3, 10, 3, 0, -10}, // 0x82 '’'
    {1715, 9, 2, 9, 0, -2}, // 0x83 '…'
};

const GrayscaleFont AtkinsonHyperlegibleNext9pt7b PROGMEM = {
    (uint8_t *)AtkinsonHyperlegibleNext9pt7bBitmaps,
    (GrayscaleGlyph *)AtkinsonHyperlegibleNext9pt7bGlyphs,
    0x20, 0x83,
    16
};
```

## src/BleManager.h
```c
#ifndef BLE_MANAGER_H
#define BLE_MANAGER_H

#include <Arduino.h>
#include <bluefruit.h>

typedef void (*BleStateCallback)(bool connected);
typedef void (*BleProgressCallback)(const String& status, int bytesReceived, bool finished);

class BleManager {
public:
    static BleManager& getInstance();

    void begin(BleStateCallback stateCb, BleProgressCallback progressCb);
    void ensureReady(); // Lazy init if not yet initialized
    void startAdvertising();
    void stopAdvertising();
    bool isConnected() const;
    void update(); // Poll for timeout

    void setPCStreamActive(bool active);
    bool isPCStreamActive() const;

    void resetTransferState();
    void processCommand(const String& cmd);

    // Central role methods
    void startScanning();
    void stopScanning();
    bool isCentralConnected() const;
    bool requestBookList(String books[], int maxBooks, int& count);
    uint32_t requestBookSize(const String& filename);
    int requestBookText(const String& filename, uint32_t offset, char* buffer, int maxLen);

private:
    BleManager();
    BleManager(const BleManager&) = delete;
    BleManager& operator=(const BleManager&) = delete;

    // Internal BLE Callbacks
    static void connect_callback(uint16_t conn_handle);
    static void disconnect_callback(uint16_t conn_handle, uint8_t reason);
    static void rx_callback(uint16_t conn_handle);

    // Central callbacks
    static void scan_callback(ble_gap_evt_adv_report_t* report);
    static void central_connect_callback(uint16_t conn_handle);
    static void central_disconnect_callback(uint16_t conn_handle, uint8_t reason);

    BleStateCallback _stateCallback;
    BleProgressCallback _progressCallback;

    bool _connected;
    bool _isTransferring;
    uint32_t _lastDataTime;
    int _bytesReceived;

    uint16_t _connHandle;
    uint32_t _expectedUploadSize;
    String _uploadTitle;
    String _cmdBuffer;

    // Central status variables
    BLEClientUart _clientUart;
    bool _centralConnected;
    bool _isScanning;
    uint16_t _centralConnHandle;
    bool _pcStreamActive;

    bool _initialized;

    static BleManager* _instance;
};

#endif // BLE_MANAGER_H
```
